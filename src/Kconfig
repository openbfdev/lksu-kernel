## src/Kconfig
```kconfig
# SPDX-License-Identifier: GPL-2.0-or-later
#
# Copyright(c) 2023 John Sanpe <sanpeqf@gmail.com>
#

config LKSU
	tristate "Linux Kernel SU Support"
	default y

choice
	prompt "Select hook function"
	default LKSU_HOOK_LSM

config LKSU_HOOK_LSM
	bool "Linux Security Module"
	depends on LKSU=y

config LKSU_HOOK_LIVEPATCH
	bool "Live Patch"
	depends on (LKSU=m) && LIVEPATCH

config LKSU_HOOK_KPROBE
	bool "Kernel Probe"
	depends on KRETPROBES

endchoice
```
